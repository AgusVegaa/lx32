// sensor_controller.sv — Double-frame_buffered Hall-effect sensor interface.
//
// Replaces the earlier stub with a real scanning FSM.
//
// Architecture:
//   - Two complete 64-entry, 16-bit frames (frame_buf[0] and frame_buf[1]).
//   - write_sel selects which frame_buffer the scanner is filling.
//   - The CPU always reads from the "stable" frame_buffer (frame_buf[~write_sel]).
//   - After scanning all 64 sensors the frame_buffers swap atomically and the
//     active_keys bitmask is rebuilt from the completed frame.
//
// ADC model:
//   For simulation, sensor values are generated by a behavioral model.
//   On FPGA, replace the adc_val assignment with SPI ADS8688 read results.
//
// Ports:
//   sensor_idx   — index for LX.SENSOR / LX.DELTA reads (0–63)
//   sensor_val   — current stable value at sensor_idx
//   delta_val    — stable[sensor_idx] − write[sensor_idx]  (velocity proxy)
//   matrix_ptr   — base address of the stable frame_buffer in sensor BRAM
//   chord_mask   — input bitmask for LX.CHORD
//   chord_match  — 1 when (active_keys & chord_mask) == chord_mask
//   snapshot_rdy — 1-cycle pulse each time a new frame completes

module sensor_controller (
    input  logic        clk,
    input  logic        rst,

    // LX32 custom-instruction datapath
    input  logic [5:0]  sensor_idx,
    output logic [15:0] sensor_val,
    output logic [31:0] matrix_ptr,
    output logic [15:0] delta_val,
    input  logic [31:0] chord_mask,
    output logic        chord_match,
    output logic        snapshot_rdy,   // one-cycle pulse per completed frame

    // Rapid-trigger unit direct read port (combinatorial, from stable frame).
    input  logic [5:0]  rt_rd_idx,
    output logic [15:0] rt_rd_val,

    // MMIO configuration / status registers
    input  logic        mmio_req,
    input  logic        mmio_we,
    input  logic [5:0]  mmio_addr,      // word offset (byte_addr[7:2])
    input  logic [31:0] mmio_wdata,
    output logic [31:0] mmio_rdata
);

  import lx32_mmio_pkg::SENSOR_DATA_BASE;
  import lx32_mmio_pkg::SENSOR_BUF_HALF;

  // ── Double-frame_buffered frame storage ─────────────────────────────────────────
  logic [15:0] frame_buf [0:1][0:63];
  logic        write_sel;          // 0 → writing frame_buf[0]; 1 → writing frame_buf[1]

  // Active-key bitmask (first 32 keys; updated at end of each scan frame).
  logic [31:0] active_keys;

  // Configurable press threshold (default 1000 ADC counts).
  logic [15:0] press_threshold;

  // ── Scanner FSM ───────────────────────────────────────────────────────────
  logic [5:0] scan_idx;   // Current sensor being scanned (0–63)

  // Behavioral ADC model for simulation.
  //   Keys 0–7  : simulated pressed  (value = 1200 > default threshold 1000).
  //   Keys 8–63 : simulated idle     (value = 800 + index < 1000).
  // Replace this block with real SPI read results on FPGA.
  logic [15:0] adc_val;
  always_comb
    adc_val = (scan_idx < 6'd8) ? 16'd1200 : (16'd800 + {10'h0, scan_idx});

  always_ff @(posedge clk or posedge rst) begin
    if (rst) begin
      scan_idx        <= 6'd0;
      write_sel       <= 1'b0;
      press_threshold <= 16'd1000;
      active_keys     <= 32'h0000_00FF;
      snapshot_rdy    <= 1'b0;
      for (int i = 0; i < 64; i++) begin
        // Both buffers pre-loaded with the converged ADC model values so that:
        //   sensor_val = adc_val[i]  (deterministic from cycle 0)
        //   delta_val  = 0           (both frames identical → no velocity)
        // This makes the gold model trivially predictable for simulation/fuzzing.
        frame_buf[0][i] <= (i < 8) ? 16'd1200 : (16'd800 + 16'(i));
        frame_buf[1][i] <= (i < 8) ? 16'd1200 : (16'd800 + 16'(i));
      end
    end else begin
      snapshot_rdy <= 1'b0;

      // Write the current ADC sample into the write frame_buffer.
      frame_buf[write_sel][scan_idx] <= adc_val;

      if (scan_idx == 6'd63) begin
        // Frame complete — swap frame_buffers.
        scan_idx     <= 6'd0;
        write_sel    <= ~write_sel;
        snapshot_rdy <= 1'b1;

        // Rebuild active_keys from the frame_buffer we just finished writing.
        // (write_sel hasn't flipped yet at this clock edge.)
        for (int k = 0; k < 32; k++)
          active_keys[k] <= (frame_buf[write_sel][k] > press_threshold);
      end else begin
        scan_idx <= scan_idx + 6'd1;
      end
    end
  end

  // ── CPU read path (combinational, from stable frame_buffer) ─────────────────────
  // The stable frame_buffer is the one NOT currently being written.
  logic rd_sel;
  assign rd_sel = ~write_sel;

  assign sensor_val  = frame_buf[rd_sel][sensor_idx];
  assign rt_rd_val   = frame_buf[rd_sel][rt_rd_idx];
  // delta = stable_value − write_value; positive means key moving toward press.
  assign delta_val   = frame_buf[rd_sel][sensor_idx] - frame_buf[write_sel][sensor_idx];
  // matrix_ptr alternates between the two halves of the sensor data BRAM.
  // write_sel==0 → CPU reads frame_buf[1] → second 32 KiB half.
  // write_sel==1 → CPU reads frame_buf[0] → first  32 KiB half.
  assign matrix_ptr  = write_sel ? SENSOR_DATA_BASE
                                 : (SENSOR_DATA_BASE + SENSOR_BUF_HALF);
  assign chord_match = ((active_keys & chord_mask) == chord_mask);

  // ── MMIO register map ─────────────────────────────────────────────────────
  // Word 0 (0x00): sensor_val for sensor_idx
  // Word 1 (0x04): matrix_ptr
  // Word 2 (0x08): delta_val for sensor_idx
  // Word 3 (0x0C): active_keys[31:0]
  // Word 4 (0x10): press_threshold (R/W)
  // Word 5 (0x14): scan_idx (read-only, for debug)
  always_ff @(posedge clk or posedge rst) begin
    if (rst)
      mmio_rdata <= 32'h0;
    else if (mmio_req) begin
      if (mmio_we) begin
        if (mmio_addr == 6'h04)
          press_threshold <= mmio_wdata[15:0];
      end else begin
        unique case (mmio_addr)
          6'h00: mmio_rdata <= {16'h0, sensor_val};
          6'h01: mmio_rdata <= matrix_ptr;
          6'h02: mmio_rdata <= {16'h0, delta_val};
          6'h03: mmio_rdata <= active_keys;
          6'h04: mmio_rdata <= {16'h0, press_threshold};
          6'h05: mmio_rdata <= {26'h0, scan_idx};
          default: mmio_rdata <= 32'hDEAD_BEEF;
        endcase
      end
    end
  end

endmodule
